## config/west.yml
```yaml
manifest:
  remotes:
    - name: zmkfirmware
      url-base: https://github.com/zmkfirmware
    - name: iwk7273
      url-base: https://github.com/iwk7273
  projects:
    - name: zmk
      remote: zmkfirmware
      revision: cb786cd7d69f2a41f2968c2e5dd6a269d417286b
      import: app/west.yml
    - name: zmk-pmw3610-driver
      remote: iwk7273
      revision: b1f7de2
    - name: zmk-feature-sensor_rotation
      remote: iwk7273
      revision: fae8988
    - name: zmk-feature-xy_clipper
      remote: iwk7273
      revision: 1e9a795
    - name: zmk-feature-scaling
      remote: iwk7273
      revision: 6a11369
    - name: zmk-smart-toggle
      remote: iwk7273
      revision: 6a5ce31
    - name: zmk-feature-meteorite-config
      remote: iwk7273
      revision: 0318fb3
  self:
    path: config
```
